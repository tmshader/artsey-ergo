## firmware/boards/shields/artsey_ergo/Kconfig.defconfig
```kconfig
config ARTSEY_SPLIT
    bool "Use split keyboard mode"
    default n

if ARTSEY_SPLIT && SHIELD_ARTSEY_ERGO_LEFT

config ZMK_SPLIT_ROLE_CENTRAL
    default y

endif

if SHIELD_ARTSEY_ERGO_LEFT || SHIELD_ARTSEY_ERGO_RIGHT

config ZMK_KEYBOARD_NAME
	default "Artsey Ergo"

if ARTSEY_SPLIT

config ZMK_SPLIT
    default y

endif # ARTSEY_SPLIT

if ZMK_DISPLAY

config I2C
    default y

config SSD1306
    default y

endif # ZMK_DISPLAY

if LVGL

config LV_Z_VDB_SIZE
    default 64

config LV_DPI_DEF
    default 148

config LV_Z_BITS_PER_PIXEL
    default 1

choice LV_COLOR_DEPTH
    default LV_COLOR_DEPTH_1
endchoice

endif # LVGL

endif
```

## firmware/boards/shields/artsey_ergo/Kconfig.shield
```kconfig
config SHIELD_ARTSEY_ERGO_LEFT
	def_bool $(shields_list_contains,artsey_ergo_left)

config SHIELD_ARTSEY_ERGO_RIGHT
	def_bool $(shields_list_contains,artsey_ergo_right)
```

## firmware/config/west.yml
```yaml
manifest:
  remotes:
    - name: zmkfirmware
      url-base: https://github.com/zmkfirmware
    - name: zmk-locales
      url-base: https://github.com/joelspadin
  projects:
    - name: zmk
      remote: zmkfirmware
      revision: main
      import: app/west.yml
    - name: zmk-locales
      remote: zmk-locales
      revision: main
  self:
    path: config
```
